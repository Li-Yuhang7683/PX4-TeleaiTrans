## src/modules/airlink/Kconfig
```kconfig
menuconfig MODULES_AIRLINK
	bool "AIRLINK dual-aircraft serial transport"
	default n
	---help---
		Build the AIRLINK v1 6 Mbaud full-duplex serial transport,
		protocol state machine, reliable events and PX4 sensor/arming
		integration.
```

## src/modules/comp_attitude/Kconfig
```kconfig
menuconfig MODULES_COMP_ATTITUDE
	bool "Composite dual-aircraft attitude estimator"
	default n
	depends on MODULES_AIRLINK
	depends on MODULES_EKF2
	---help---
		Run an independent EKF2 core using the 0.5/0.5 master and slave IMUs.
		Both aircraft map to independent composite FRD before fusion
		(default A->C=-30 deg, B->C=+30 deg, q_AB=+60 deg). Publishes
		estimate, health and yaw topics.
```
